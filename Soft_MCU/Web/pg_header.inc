    <head>
      <style>
        .maintbl {
          width:99%;
          height:100%;
        }
        @media screen and (min-width: 601px) {
          .maintbl {width:600px}
        }
      </style>
    </head>
    <body bgColor="#ffffff" leftMargin="0" topMargin="10" marginwidth="0" marginheight="0">
    <div align="center">
    <table cellSpacing="0" cellPadding="0" class="maintbl">
      <tbody>
        <tr style="background-color:rgb(0,92,167)">
          <td style="border-bottom:1px solid #000080" noWrap height="46">
            <h3 align="center"><font face="verdana" color="#FFFFFF">Profibus-DP to Ethernet</font></h3>
          </td>
          <td style="border-bottom:1px solid #000080" noWrap height="46" width="25%">
            <a href="http://www.sl-automation.com/"><img src="logo.gif" align="middle" width="100%" border="0"></a>
          </td>
        </tr>
        <tr><td colSpan="5" vAlign="top" style="background-color:rgb(214,226,242)" width="100%">
        <div align="center">
          <center><font face="verdana">
            <table border="0" align="center" width="100%">
            <tbody><tr><td width="95%">